## buildroot/configs/luckfox_pico_defconfig
```kconfig
# Architecture
BR2_arm=y
BR2_cortex_a7=y
BR2_ARM_EABIHF=y
BR2_ARM_FPU_VFPV4D16=y

# Build internal toolchain instead of using external LuckFox toolchain
# This allows us to use GCC >= 8.4 which is required for NumPy 1.25.0
# Using musl instead of uclibc because NumPy requires glibc or musl (not uclibc)
BR2_TOOLCHAIN_BUILDROOT=y
BR2_TOOLCHAIN_BUILDROOT_MUSL=y
BR2_TOOLCHAIN_BUILDROOT_WCHAR=y
BR2_TOOLCHAIN_BUILDROOT_CXX=y
BR2_GCC_VERSION_11_X=y
BR2_KERNEL_HEADERS_5_10=y

# System
BR2_TARGET_GENERIC_HOSTNAME="luckfox"
BR2_TARGET_GENERIC_ISSUE="SeedSigner on LuckFox Pico"
BR2_TARGET_GENERIC_GETTY_PORT="ttyFIQ0"
BR2_INIT_SYSV=y
BR2_ROOTFS_DEVICE_CREATION_DYNAMIC_EUDEV=y
BR2_TARGET_GENERIC_ROOT_PASSWD="luckfox"
BR2_ROOTFS_OVERLAY="/build/rootfs-overlay"
BR2_ROOTFS_POST_BUILD_SCRIPT="board/rockchip/rv1106_rv1103/fs-overlay-spi-nand/post-build.sh"

# Linux
BR2_LINUX_KERNEL=y
BR2_LINUX_KERNEL_CUSTOM_VERSION=y
BR2_LINUX_KERNEL_CUSTOM_VERSION_VALUE="5.10.160"
BR2_LINUX_KERNEL_USE_CUSTOM_CONFIG=y
BR2_LINUX_KERNEL_CUSTOM_CONFIG_FILE="$(BR2_EXTERNAL)/../kernel/arch/arm/configs/luckfox_rv1106_linux_defconfig"
BR2_LINUX_KERNEL_LZO=y
BR2_LINUX_KERNEL_DTS_SUPPORT=y
BR2_LINUX_KERNEL_CUSTOM_DTS_PATH="$(BR2_EXTERNAL)/../kernel/arch/arm/boot/dts/rv1106g-luckfox-pico-pro-max.dts"
BR2_LINUX_KERNEL_DTB_OVERLAY_SUPPORT=y
BR2_LINUX_KERNEL_INSTALL_TARGET=y

# Filesystem
BR2_TARGET_ROOTFS_UBIFS=y
BR2_TARGET_ROOTFS_UBIFS_LEBSIZE=0x1f000
BR2_TARGET_ROOTFS_UBIFS_MINIOSIZE=0x1000
BR2_TARGET_ROOTFS_UBIFS_MAXLEBCNT=1024
BR2_TARGET_ROOTFS_UBI=y
BR2_TARGET_ROOTFS_UBI_PEBSIZE=0x20000
BR2_TARGET_ROOTFS_UBI_SUBSIZE=2048

# U-Boot
BR2_TARGET_UBOOT=y
BR2_TARGET_UBOOT_CUSTOM_VERSION=y
BR2_TARGET_UBOOT_CUSTOM_VERSION_VALUE="2017.09"
BR2_TARGET_UBOOT_BOARD_DEFCONFIG="rv1106"
BR2_TARGET_UBOOT_NEEDS_DTC=y
BR2_TARGET_UBOOT_FORMAT_BIN=y
BR2_TARGET_UBOOT_SPL=y
BR2_TARGET_UBOOT_SPL_NAME="spl/u-boot-spl.bin"

# Packages
BR2_PACKAGE_BUSYBOX_CONFIG="package/busybox/busybox-minimal.config"
BR2_PACKAGE_ALSA_UTILS=y
BR2_PACKAGE_ALSA_UTILS_SPEAKER_TEST=y
BR2_PACKAGE_E2FSPROGS=y
BR2_PACKAGE_E2FSPROGS_FSCK=y
BR2_PACKAGE_E2FSPROGS_RESIZE2FS=y
BR2_PACKAGE_GETTEXT=y
BR2_PACKAGE_GETTEXT_GNU=y

# V4L/Camera support
BR2_PACKAGE_LIBV4L=y
BR2_PACKAGE_LIBV4L_UTILS=y

# Python 3
BR2_PACKAGE_PYTHON3=y
BR2_PACKAGE_PYTHON3_PYC_ONLY=y
BR2_PACKAGE_PYTHON3_CODECSCJK=y
BR2_PACKAGE_PYTHON3_SSL=y
BR2_PACKAGE_PYTHON3_UNICODEDATA=y
BR2_PACKAGE_PYTHON3_PYEXPAT=y
BR2_PACKAGE_PYTHON3_ZLIB=y

# Python packages (standard)
BR2_PACKAGE_PYTHON_CFFI=y
BR2_PACKAGE_PYTHON_PYCPARSER=y
BR2_PACKAGE_PYTHON_PERIPHERY=y
BR2_PACKAGE_PYTHON_PILLOW=y
BR2_PACKAGE_PYTHON_PYQRCODE=y
BR2_PACKAGE_PYTHON_QRCODE=y
BR2_PACKAGE_PYTHON_SETUPTOOLS=y
BR2_PACKAGE_PYTHON_SMBUS_CFFI=y
BR2_PACKAGE_PYTHON_SPIDEV=y
BR2_PACKAGE_PYTHON_TYPING_EXTENSIONS=y

# Python SeedSigner dependencies
BR2_PACKAGE_PYTHON_CERTIFI=y
BR2_PACKAGE_PYTHON_COLORAMA=y
BR2_PACKAGE_PYTHON_ECDSA=y
BR2_PACKAGE_PYTHON_SIX=y

# OpenCV support - using buildroot's bundled numpy with new uclibc toolchain
BR2_PACKAGE_PYTHON_NUMPY=y
BR2_PACKAGE_OPENCV_MOBILE=y
BR2_PACKAGE_OPENCV_MOBILE_PYTHON=y

# External packages (smartcard/NFC)
BR2_PACKAGE_CCID_SEC1210=y
BR2_PACKAGE_OPENCT=y
BR2_PACKAGE_IFDNFC=y
BR2_PACKAGE_NFC_BINDINGS=y
BR2_PACKAGE_PYTHON_PYSCARD=y
BR2_PACKAGE_PYTHON_PYSATOCHIP=y

# External packages (SeedSigner Python dependencies)
BR2_PACKAGE_PYTHON_SHAMIR_MNEMONIC=y
BR2_PACKAGE_PYTHON_PYAES=y
BR2_PACKAGE_PYTHON_PGPY=y
BR2_PACKAGE_PYTHON_PYCRYPTODOMEX=y
BR2_PACKAGE_PYTHON_SMBUS2=y

# Embit
BR2_PACKAGE_PYTHON_EMBIT=y

# URTypes
BR2_PACKAGE_PYTHON_URTYPES=y

# Pyzbar (for QR decoding)
BR2_PACKAGE_PYTHON_PYZBAR=y

# Networking
BR2_PACKAGE_DROPBEAR=y
BR2_PACKAGE_IPTABLES=y
BR2_PACKAGE_NTPD=y
```

## buildroot/external-packages/ccid-sec1210/Config.in
```kconfig
config BR2_PACKAGE_CCID_SEC1210
	bool "ccid-sec1210"
	select BR2_PACKAGE_PCSC_LITE
	select BR2_PACKAGE_LIBUSB
	help
	  CCID (Chip Card Interface Device) driver with SEC1210 serial reader support.
	  This package provides support for USB and serial smartcard readers.

	  https://github.com/LudovicRousseau/CCID
```

## buildroot/external-packages/ifdnfc/Config.in
```kconfig
config BR2_PACKAGE_IFDNFC
	bool "ifdnfc"
	depends on BR2_PACKAGE_PCSC_LITE
	depends on BR2_PACKAGE_LIBNFC
	select BR2_PACKAGE_PCSC_LITE
	select BR2_PACKAGE_LIBNFC
	help
	  PC/SC IFD Handler implementation for NFC-based smartcard readers.
	  Enables NFC reader support with PCSC-lite daemon.

	  https://github.com/3rdIteration/ifdnfc
```

## buildroot/external-packages/nfc-bindings/Config.in
```kconfig
config BR2_PACKAGE_NFC_BINDINGS
	bool "nfc-bindings"
	select BR2_PACKAGE_LIBNFC
	select BR2_PACKAGE_LIBUSB
	select BR2_PACKAGE_LIBUSB_COMPAT
	help
	  Python bindings for libnfc - Near Field Communication library.
	  Enables NFC operations from Python applications.

	  https://github.com/3rdIteration/nfc-bindings
```

## buildroot/external-packages/openct/Config.in
```kconfig
config BR2_PACKAGE_OPENCT
	bool "openct"
	select BR2_PACKAGE_PCSC_LITE
	help
	  OpenCT - Smartcard terminal middleware library.
	  Provides drivers for various smartcard readers and tokens.

	  https://github.com/3rdIteration/openct
```

## buildroot/external-packages/opencv-mobile/Config.in
```kconfig
config BR2_PACKAGE_OPENCV_MOBILE
	bool "opencv-mobile"
	depends on BR2_INSTALL_LIBSTDCPP
	depends on BR2_TOOLCHAIN_HAS_THREADS
	depends on BR2_USE_WCHAR
	help
	  Minimal build of OpenCV library for mobile and embedded platforms.
	  
	  opencv-mobile provides core computer vision functionality with
	  minimal size and dependencies. Perfect for embedded systems.
	  
	  This package is optimized for LuckFox Pico (uclibc) and includes
	  essential modules: core, imgproc, features2d, photo, and video.
	  
	  https://github.com/nihui/opencv-mobile

if BR2_PACKAGE_OPENCV_MOBILE

config BR2_PACKAGE_OPENCV_MOBILE_PYTHON
	bool "Python bindings"
	depends on BR2_PACKAGE_PYTHON3
	select BR2_PACKAGE_PYTHON_NUMPY
	help
	  Build Python 3 bindings for opencv-mobile (cv2 module).
	  
	  This enables using OpenCV from Python for image processing
	  and camera operations.
	  
	  Note: Adds approximately 1-2 MB to the final image.

endif

comment "opencv-mobile needs a toolchain w/ C++, threads, wchar"
	depends on !BR2_INSTALL_LIBSTDCPP || !BR2_TOOLCHAIN_HAS_THREADS || !BR2_USE_WCHAR
```

## buildroot/external-packages/python-numpy/Config.in
```kconfig
config BR2_PACKAGE_PYTHON_NUMPY
	bool "python-numpy"
	depends on BR2_PACKAGE_PYTHON3
	depends on BR2_TOOLCHAIN_USES_GLIBC || BR2_TOOLCHAIN_USES_UCLIBC || BR2_TOOLCHAIN_USES_MUSL
	help
	  NumPy is the fundamental package for scientific computing
	  with Python.

	  This is a custom build of NumPy 1.24.3, which works with
	  GCC >= 8.0 (compatible with LuckFox GCC 8.3.0).

	  The standard buildroot python-numpy is version 1.25.0 which
	  requires GCC >= 8.4, which is not available in the LuckFox
	  toolchain.

	  Built without BLAS/LAPACK for simplicity on embedded systems.

	  https://numpy.org/
```

## buildroot/external-packages/python-pyaes/Config.in
```kconfig
config BR2_PACKAGE_PYTHON_PYAES
	bool "python-pyaes"
	help
	  Pure-Python implementation of AES block-cipher and common modes of operation.
	  
	  https://github.com/ricmoo/pyaes
```

## buildroot/external-packages/python-pycryptodomex/Config.in
```kconfig
config BR2_PACKAGE_PYTHON_PYCRYPTODOMEX
	bool "python-pycryptodomex"
	help
	  Cryptographic library for Python (standalone version).
	  
	  PyCryptodomex is a self-contained Python package of low-level
	  cryptographic primitives. It's a fork of PyCrypto that brings
	  several enhancements.
	  
	  https://www.pycryptodome.org/
```

## buildroot/external-packages/python-pyscard/Config.in
```kconfig
config BR2_PACKAGE_PYTHON_PYSCARD
	bool "python-pyscard"
	select BR2_PACKAGE_PCSC_LITE
	help
	  Python smartcard library - pyscard.
	  Smart card support for Python with PC/SC.

	  https://github.com/LudovicRousseau/pyscard
```

## buildroot/external-packages/python-shamir-mnemonic/Config.in
```kconfig
config BR2_PACKAGE_PYTHON_SHAMIR_MNEMONIC
	bool "python-shamir-mnemonic"
	help
	  Reference implementation of SLIP-0039: Shamir's Secret-Sharing for Mnemonic Codes
	  
	  This is a Python implementation of the SLIP-0039 standard for splitting BIP-39
	  mnemonics into multiple shares using Shamir's Secret Sharing scheme.
	  
	  https://github.com/trezor/python-shamir-mnemonic
```

## buildroot/external-packages/python-smbus2/Config.in
```kconfig
config BR2_PACKAGE_PYTHON_SMBUS2
	bool "python-smbus2"
	depends on !BR2_STATIC_LIBS # i2c-tools
	help
	  A drop-in replacement for smbus-cffi/smbus-python in pure Python.
	  
	  smbus2 is a pure Python implementation of the SMBus/I2C interface
	  for communicating with I2C/SMBus devices.
	  
	  https://github.com/kplindegaard/smbus2

comment "python-smbus2 needs a toolchain w/ dynamic library"
	depends on BR2_STATIC_LIBS
```
