## buildroot/external-packages/python-pgpy/Config.in
```kconfig
config BR2_PACKAGE_PYTHON_PGPY
	bool "python-pgpy"
	select BR2_PACKAGE_PYTHON_PYCRYPTODOMEX
	select BR2_PACKAGE_PYTHON_PYASN1
	select BR2_PACKAGE_PYTHON_ECDSA
	help
      Pretty Good Privacy (PGP) implementation in Python.
      Uses pycryptodomex as the cryptographic backend
      (no python-cryptography/Rust dependency).

	  https://github.com/3rdIteration/PGPy
```
